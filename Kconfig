## Kconfig
```kconfig
# SPDX-License-Identifier: GPL-2.0-only

config DRM_SMI
	tristate "SiliconMotion SM750/SM768 DRM driver"
	depends on DRM && PCI && MMU && SND
	select DRM_CLIENT_SELECTION
	select DRM_VRAM_HELPER
	select DRM_KMS_HELPER
	select DRM_TTM
	select DRM_TTM_HELPER
	select SND_PCM
	help
		Say yes for SiliconMotion SM750/SM768 DRM driver.
```
